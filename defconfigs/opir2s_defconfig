## defconfigs/opir2s_defconfig
```kconfig
CONFIG_TARGET_ky=y
CONFIG_TARGET_ky_riscv64_DEVICE_x1_orangepi-r2s=y
CONFIG_TARGET_KERNEL_PARTSIZE=512
CONFIG_TARGET_ROOTFS_PARTSIZE=800
CONFIG_TARGET_ROOTFS_PERSIST_VAR=y
CONFIG_EXPERIMENTAL=y
CONFIG_INCLUDE_CONFIG=y
CONFIG_KERNEL_BUILD_DOMAIN="bra.live"
CONFIG_KERNEL_SLUB_DEBUG=y
CONFIG_KERNEL_DEVTMPFS=y
CONFIG_KERNEL_CGROUP_FREEZER=y
CONFIG_KERNEL_CGROUP_DEVICE=y
CONFIG_KERNEL_NET_CLS_CGROUP=y
CONFIG_KERNEL_CGROUP_NET_PRIO=y
CONFIG_DEVEL=y
CONFIG_IMAGEOPT=y
CONFIG_TARGET_DEFAULT_LAN_IP_FROM_PREINIT=y
CONFIG_PREINITOPT=y
CONFIG_TARGET_PREINIT_IP="10.0.2.1"
CONFIG_TARGET_PREINIT_BROADCAST="10.0.2.255"
CONFIG_VERSIONOPT=y
CONFIG_VERSION_NUMBER="24.10"
CONFIG_VERSION_CODE="20251230-r0-1d257ec"
CONFIG_VERSION_HOME_URL="https://bra.live"
CONFIG_VERSION_MANUFACTURER="Bra, LLC"
CONFIG_VERSION_MANUFACTURER_URL="https://bra.live"
CONFIG_VERSION_SUPPORT_URL="https://bra.live"
CONFIG_VERSION_PRODUCT="BraWrt"
# CONFIG_FEED_nikki is not set
CONFIG_BUSYBOX_CUSTOM=y
CONFIG_BUSYBOX_CONFIG_FEATURE_GZIP_LONG_OPTIONS=y
CONFIG_BUSYBOX_CONFIG_FEATURE_GZIP_LEVELS=y
CONFIG_BUSYBOX_CONFIG_FEATURE_TAR_LONG_OPTIONS=y
CONFIG_BUSYBOX_CONFIG_FEATURE_TAR_AUTODETECT=y
CONFIG_BUSYBOX_CONFIG_FEATURE_CATN=y
CONFIG_BUSYBOX_CONFIG_FEATURE_CATV=y
CONFIG_BUSYBOX_CONFIG_FEATURE_CP_LONG_OPTIONS=y
CONFIG_BUSYBOX_CONFIG_FEATURE_CP_REFLINK=y
CONFIG_BUSYBOX_CONFIG_FEATURE_CUT_REGEX=y
CONFIG_BUSYBOX_CONFIG_FEATURE_DATE_NANO=y
CONFIG_BUSYBOX_CONFIG_FEATURE_DATE_COMPAT=y
CONFIG_BUSYBOX_CONFIG_FEATURE_DD_STATUS=y
CONFIG_BUSYBOX_CONFIG_FEATURE_DF_FANCY=y
CONFIG_BUSYBOX_CONFIG_NOHUP=y
CONFIG_BUSYBOX_CONFIG_NPROC=y
CONFIG_BUSYBOX_CONFIG_REALPATH=y
CONFIG_BUSYBOX_CONFIG_FEATURE_SORT_BIG=y
CONFIG_BUSYBOX_CONFIG_STAT=y
CONFIG_BUSYBOX_CONFIG_FEATURE_STAT_FORMAT=y
CONFIG_BUSYBOX_CONFIG_FEATURE_STAT_FILESYSTEM=y
CONFIG_BUSYBOX_CONFIG_TIMEOUT=y
CONFIG_BUSYBOX_CONFIG_FEATURE_TR_CLASSES=y
CONFIG_BUSYBOX_CONFIG_FEATURE_TR_EQUIV=y
CONFIG_BUSYBOX_CONFIG_TRUNCATE=y
CONFIG_BUSYBOX_CONFIG_BASE64=y
CONFIG_BUSYBOX_CONFIG_FEATURE_WC_LARGE=y
CONFIG_BUSYBOX_CONFIG_WHOAMI=y
CONFIG_BUSYBOX_CONFIG_DIFF=y
CONFIG_BUSYBOX_CONFIG_FEATURE_DIFF_LONG_OPTIONS=y
CONFIG_BUSYBOX_CONFIG_FEATURE_DIFF_DIR=y
CONFIG_BUSYBOX_CONFIG_PATCH=y
CONFIG_BUSYBOX_CONFIG_FEATURE_VI_8BIT=y
CONFIG_BUSYBOX_CONFIG_FEATURE_VI_COLON_EXPAND=y
CONFIG_BUSYBOX_CONFIG_FEATURE_VI_UNDO=y
CONFIG_BUSYBOX_CONFIG_FEATURE_VI_UNDO_QUEUE=y
CONFIG_BUSYBOX_CONFIG_FEATURE_VI_UNDO_QUEUE_MAX=32
CONFIG_BUSYBOX_CONFIG_FEATURE_VI_VERBOSE_STATUS=y
CONFIG_BUSYBOX_CONFIG_FEATURE_FIND_ATIME=y
CONFIG_BUSYBOX_CONFIG_FEATURE_FIND_CTIME=y
CONFIG_BUSYBOX_CONFIG_FEATURE_FIND_AMIN=y
CONFIG_BUSYBOX_CONFIG_FEATURE_FIND_CMIN=y
CONFIG_BUSYBOX_CONFIG_FEATURE_FIND_EXECUTABLE=y
CONFIG_BUSYBOX_CONFIG_FEATURE_FIND_INUM=y
CONFIG_BUSYBOX_CONFIG_FEATURE_FIND_SAMEFILE=y
CONFIG_BUSYBOX_CONFIG_FEATURE_FIND_EXEC_PLUS=y
CONFIG_BUSYBOX_CONFIG_FEATURE_FIND_QUIT=y
CONFIG_BUSYBOX_CONFIG_FEATURE_FIND_DELETE=y
CONFIG_BUSYBOX_CONFIG_FEATURE_FIND_EMPTY=y
CONFIG_BUSYBOX_CONFIG_FEATURE_FIND_LINKS=y
CONFIG_BUSYBOX_CONFIG_FEATURE_XARGS_SUPPORT_REPL_STR=y
CONFIG_BUSYBOX_CONFIG_FEATURE_XARGS_SUPPORT_PARALLEL=y
CONFIG_BUSYBOX_CONFIG_FEATURE_XARGS_SUPPORT_ARGS_FILE=y
CONFIG_BUSYBOX_CONFIG_DEPMOD=y
CONFIG_BUSYBOX_CONFIG_INSMOD=y
CONFIG_BUSYBOX_CONFIG_LSMOD=y
CONFIG_BUSYBOX_CONFIG_FEATURE_LSMOD_PRETTY_2_6_OUTPUT=y
CONFIG_BUSYBOX_CONFIG_MODINFO=y
CONFIG_BUSYBOX_CONFIG_MODPROBE=y
CONFIG_BUSYBOX_CONFIG_FEATURE_MODPROBE_BLACKLIST=y
CONFIG_BUSYBOX_CONFIG_RMMOD=y
CONFIG_BUSYBOX_CONFIG_BLKID=y
CONFIG_BUSYBOX_CONFIG_FEATURE_BLKID_TYPE=y
CONFIG_BUSYBOX_CONFIG_FDISK=y
CONFIG_BUSYBOX_CONFIG_FEATURE_FDISK_WRITABLE=y
CONFIG_BUSYBOX_CONFIG_FEATURE_OSF_LABEL=y
CONFIG_BUSYBOX_CONFIG_FEATURE_GPT_LABEL=y
CONFIG_BUSYBOX_CONFIG_LSPCI=y
CONFIG_BUSYBOX_CONFIG_MKE2FS=y
CONFIG_BUSYBOX_CONFIG_MKFS_EXT2=y
CONFIG_BUSYBOX_CONFIG_MKDOSFS=y
CONFIG_BUSYBOX_CONFIG_MKFS_VFAT=y
CONFIG_BUSYBOX_CONFIG_FEATURE_MKSWAP_UUID=y
CONFIG_BUSYBOX_CONFIG_HDPARM=y
CONFIG_BUSYBOX_CONFIG_TREE=y
CONFIG_BUSYBOX_CONFIG_WATCHDOG=y
CONFIG_BUSYBOX_CONFIG_FEATURE_SHOW_THREADS=y
CONFIG_BUSYBOX_CONFIG_FUSER=y
CONFIG_BUSYBOX_CONFIG_IOSTAT=y
CONFIG_BUSYBOX_CONFIG_MPSTAT=y
CONFIG_BUSYBOX_CONFIG_PKILL=y
CONFIG_BUSYBOX_CONFIG_FEATURE_PIDOF_SINGLE=y
CONFIG_BUSYBOX_CONFIG_FEATURE_PIDOF_OMIT=y
CONFIG_BUSYBOX_CONFIG_FEATURE_PS_LONG=y
CONFIG_BUSYBOX_CONFIG_PSTREE=y
CONFIG_BUSYBOX_CONFIG_FEATURE_TOP_INTERACTIVE=y
CONFIG_BUSYBOX_CONFIG_FEATURE_TOP_SMP_CPU=y
CONFIG_BUSYBOX_CONFIG_FEATURE_TOP_DECIMALS=y
CONFIG_BUSYBOX_CONFIG_FEATURE_TOP_SMP_PROCESS=y
CONFIG_BUSYBOX_CONFIG_FEATURE_TOPMEM=y
CONFIG_BUSYBOX_CONFIG_WATCH=y
CONFIG_PACKAGE_ca-certificates=y
CONFIG_DROPBEAR_ZLIB=y
CONFIG_PACKAGE_libstdcpp=y
CONFIG_PACKAGE_resolveip=y
CONFIG_PACKAGE_rpcd-mod-rpcsys=y
CONFIG_PACKAGE_kmod-crypto-ccm=y
CONFIG_PACKAGE_kmod-crypto-cmac=y
CONFIG_PACKAGE_kmod-crypto-gcm=y
CONFIG_PACKAGE_kmod-crypto-md5=y
CONFIG_PACKAGE_kmod-fs-btrfs=y
CONFIG_PACKAGE_kmod-fs-cifs=m
CONFIG_PACKAGE_kmod-fs-exfat=y
CONFIG_PACKAGE_kmod-fs-ext4=y
CONFIG_PACKAGE_kmod-fs-jfs=m
CONFIG_PACKAGE_kmod-fs-msdos=y
CONFIG_PACKAGE_kmod-fs-nfs-v4=m
CONFIG_PACKAGE_kmod-fs-ntfs3=y
CONFIG_PACKAGE_kmod-fs-squashfs=m
CONFIG_PACKAGE_kmod-nls-cp1250=y
CONFIG_PACKAGE_kmod-nls-cp1251=y
CONFIG_PACKAGE_kmod-nls-cp775=y
CONFIG_PACKAGE_kmod-nls-cp850=y
CONFIG_PACKAGE_kmod-nls-cp852=y
CONFIG_PACKAGE_kmod-nls-cp866=y
CONFIG_PACKAGE_kmod-nls-cp932=y
CONFIG_PACKAGE_kmod-nls-cp936=y
CONFIG_PACKAGE_kmod-nls-cp950=y
CONFIG_PACKAGE_kmod-nls-iso8859-13=y
CONFIG_PACKAGE_kmod-nls-iso8859-15=y
CONFIG_PACKAGE_kmod-nls-iso8859-2=y
CONFIG_PACKAGE_kmod-nls-koi8r=y
CONFIG_PACKAGE_kmod-ipt-nat6=y
CONFIG_PACKAGE_kmod-ipt-physdev=y
CONFIG_PACKAGE_kmod-nf-ipvs=y
CONFIG_PACKAGE_kmod-nft-socket=y
CONFIG_PACKAGE_kmod-nft-tproxy=y
CONFIG_PACKAGE_kmod-dummy=y
CONFIG_PACKAGE_kmod-ifb=y
CONFIG_PACKAGE_kmod-r8169=y
CONFIG_PACKAGE_kmod-inet-diag=y
CONFIG_PACKAGE_kmod-netlink-diag=y
CONFIG_PACKAGE_kmod-sched-cake=y
CONFIG_PACKAGE_kmod-tcp-bbr=y
CONFIG_PACKAGE_kmod-tun=y
CONFIG_PACKAGE_kmod-veth=y
CONFIG_PACKAGE_kmod-usb-net-rndis=y
CONFIG_PACKAGE_kmod-usb-net-rtl8152=y
CONFIG_PACKAGE_kmod-usb-printer=y
CONFIG_PACKAGE_kmod-usb-storage-extras=y
CONFIG_PACKAGE_kmod-usb-storage-uas=y
CONFIG_PACKAGE_kmod-usb3=y
CONFIG_PACKAGE_ucode-mod-uloop=y
CONFIG_PACKAGE_libcap=y
CONFIG_PACKAGE_libevent2-pthreads=y
CONFIG_PACKAGE_libltdl=y
CONFIG_PACKAGE_libpcre2=y
CONFIG_PACKAGE_libpopt=y
CONFIG_PACKAGE_libuci-lua=y
CONFIG_PACKAGE_libunistring=y
CONFIG_PACKAGE_libusb-1.0=y
CONFIG_PACKAGE_libustream-mbedtls=m
CONFIG_LUCI_LANG_ru=y
CONFIG_PACKAGE_default-settings=y
CONFIG_PACKAGE_ip6tables-nft=y
CONFIG_PACKAGE_iptables-mod-conntrack-extra=y
CONFIG_PACKAGE_iptables-mod-extra=y
CONFIG_PACKAGE_iptables-mod-ipopt=y
CONFIG_PACKAGE_iptables-nft=y
CONFIG_PACKAGE_ip-full=y
CONFIG_PACKAGE_tc-tiny=y
CONFIG_PACKAGE_ethtool-full=y
CONFIG_PACKAGE_ipset=y
CONFIG_PACKAGE_tcpdump=y
CONFIG_PACKAGE_bzip2=y
CONFIG_PACKAGE_blkid=y
CONFIG_PACKAGE_lsblk=y
CONFIG_PACKAGE_sysfsutils=y
CONFIG_PACKAGE_dmesg=y
CONFIG_PACKAGE_more=y
CONFIG_PACKAGE_openssl-util=y
CONFIG_PACKAGE_ucode-mod-uclient=y
CONFIG_PACKAGE_conntrack=y
CONFIG_BUSYBOX_CONFIG_LSMOD=y
```
